## meta-flax/conf/layer.conf
```bitbake
BBPATH =. "${LAYERDIR}:"

# Fix for meta-common being incomplete
BBFILES += " \
        ${TOPDIR}/meta-common/recipes-*/*/*/*.bb \
        ${TOPDIR}/meta-common/recipes-*/*/*/*.bbappend \
        ${TOPDIR}/meta-common/recipes-*/*/*/*/*.bbappend \
        ${TOPDIR}/meta-common/meta-common/recipes-*/*/*.bb \ 
        ${TOPDIR}/meta-common/meta-common/recipes-*/*/*.bbappend \
"

BBFILES += "${LAYERDIR}/recipes-*/*/*.bb \
            ${LAYERDIR}/recipes-*/*/*.bbappend \
            ${LAYERDIR}/meta-common/recipes-*/*/*.bb \
            ${LAYERDIR}/meta-common/recipes-*/*/*.bbappend \
"

BBFILE_COLLECTIONS += "flax"
BBFILE_PATTERN_flax = "^${LAYERDIR}/"
BBFILE_PRIORITY_flax = "20"


LAYERSERIES_COMPAT_flax = "scarthgap"

# MASK out meta-ami dangling recipes:
#
BBMASK .= " \
  /home/vagrant/openbmc-ami/meta-ami/meta-common/recipes-security/google-authenticator-libpam/google-authenticator-libpam_%.bbappend \
  /home/vagrant/openbmc-ami/meta-ami/meta-common/recipes-intel/images/intel-platforms.bbappend \
  /home/vagrant/openbmc-ami/meta-ami/meta-common/recipes-phosphor/setting/settings_%.bbappend \
  /home/vagrant/openbmc-ami/meta-ami/meta-common/recipes-phosphor/ipmi/intel-ipmi-oem_%.bbappend \
  /home/vagrant/openbmc-ami/meta-ami/meta-common/recipes-phosphor/fru/default-fru.bbappend \
  /home/vagrant/openbmc-ami/meta-ami/meta-common/recipes-phosphor/pmci/pldmd.bbappend \
  /home/vagrant/openbmc-ami/meta-ami/meta-common/recipes-phosphor/pmci/libpldm-intel_%.bbappend \
  /home/vagrant/openbmc-ami/meta-ami/meta-common/recipes-phosphor/pmci/mctpd.bbappend \
  /home/vagrant/openbmc-ami/meta-ami/meta-common/recipes-phosphor/pmci/mctp-wrapper.bbappend \
  /home/vagrant/openbmc-ami/meta-ami/meta-common/recipes-phosphor/prov-mode-mgr/prov-mode-mgr_%.bbappend \
  /home/vagrant/openbmc-ami/meta-ami/meta-common/recipes-phosphor/sel-logger/phosphor-sel-logger_%.bbappend \
  /home/vagrant/openbmc-ami/meta-ami/meta-common/recipes-network/network/static-mac-addr.bbappend \
  /home/vagrant/openbmc-ami/meta-ami/meta-tiogapass/recipes-x86/chassis/x86-power-control_%.bbappend \
  /home/vagrant/openbmc-ami/meta-common/meta-common/recipes-core/host-error-monitor/host-error-monitor_%.bbappend \
  /home/vagrant/openbmc-ami/meta-common/meta-common/recipes-core/libespi/libespi_git.bb \
  /home/vagrant/openbmc-ami/meta-common/meta-common/recipes-core/ipmi/intel-ipmi-oem_%.bbappend \
  /home/vagrant/openbmc-ami/meta-common/meta-common/recipes-kernel/linux/linux-aspeed_%.bbappend \
  /home/vagrant/openbmc-ami/meta-common/meta-common/recipes-security/sssd/sssd_%.bbappend \
  /home/vagrant/openbmc-ami/meta-common/meta-common/recipes-intel/host-misc-comm-manager/host-misc-comm-manager_git.bb \
  /home/vagrant/openbmc-ami/meta-common/meta-common/recipes-intel/psu-manager/psu-manager.bb \
  /home/vagrant/openbmc-ami/meta-common/meta-common/recipes-phosphor/datetime/phosphor-time-manager_git.bbappend \
  /home/vagrant/openbmc-ami/meta-common/meta-common/recipes-phosphor/special-mode-mgr/special-mode-mgr_git.bb \
  /home/vagrant/openbmc-ami/meta-common/meta-common/recipes-phosphor/settings/settings_git.bb \
  /home/vagrant/openbmc-ami/meta-common/meta-common/recipes-phosphor/pmci/mctpwplus.bb \
  /home/vagrant/openbmc-ami/meta-common/meta-common/recipes-phosphor/pmci/nvmemi-daemon.bb \
  /home/vagrant/openbmc-ami/meta-common/meta-common/recipes-phosphor/pmci/pmci-launcher.bb \
  /home/vagrant/openbmc-ami/meta-common/meta-common/recipes-phosphor/pmci/libpldm-intel_git.bb \
  /home/vagrant/openbmc-ami/meta-common/meta-common/recipes-phosphor/pmci/pldmd.bb \
  /home/vagrant/openbmc-ami/meta-common/meta-common/recipes-phosphor/pmci/libmctp-intel_git.bb \
  /home/vagrant/openbmc-ami/meta-common/meta-common/recipes-phosphor/pmci/mctpd.bb \
  /home/vagrant/openbmc-ami/meta-common/meta-common/recipes-phosphor/prov-mode-mgr/prov-mode-mgr_git.bb \
  /home/vagrant/openbmc-ami/meta-common/meta-common/recipes-phosphor/security-manager/security-manager_git.bb \
  /home/vagrant/openbmc-ami/meta-flax/meta-common/recipes-phosphor/priv-mode-mgr/prov-mode-mgr_git.bbappend \
"



OBMC_IMAGE_EXTRA_INSTALL:append = " phosphor-ipmi-net phosphor-ipmi-blobs phosphor-ipmi-blobs-binarystore smbios-mdr ipmitool"
#IMAGE_INSTALL:append = " phosphor-user-manager-default-admin"
#IMAGE_INSTALL:append = " phosphor-state-manager-chassis phosphor-state-manager-host"

IMAGE_INSTALL:remove = "obmc-settings-mgmt settings_git nss-pam-radiusd"
IMAGE_FEATURES:remove = "onetree-radius-client" 
PACKAGECONFG:remove:pn-obmc-phosphor-image = "obmc-settings-mgmt"
          
# causes a conflict between dropbear and ssh
IMAGE_INSTALL:remove = "ami-fw-update"

# default fru provide bad dummy information
RDEPENDS:packagegroup-onetree-apps-fru:remove = "default-fru"
RDEPENDS:packagegroup-onetree-apps-prov-mode-mgr:remove = "prov-mode-mgr"
# settings needed for SOL (xyz.openbmc_project.Ipmi.SOL)
#RDEPENDS:packagegroup-obmc-apps-settings:remove = "settings"
PACKAGE_EXCLUDE += "prov-mode-mgr"

FEATURE_PACKAGES_onetree-bmc-services-ready = ""
FEATURE_PACKAGES_onetree-extlog = ""
FEATURE_PACKAGES_onetree-fru = ""
FEATURE_PACKAGES_onetree-gpio-presence = ""
FEATURE_PACKAGES_onetree-host-error = ""
FEATURE_PACKAGES_onetree-host-interface = ""
# settings needed for SOL (xyz.openbmc_project.Ipmi.SOL)
#FEATURE_PACKAGES_settings = ""
#FEATURE_PACKAGES_obmc-settings-mgmt = ""
```

## meta-flax/conf/machine/tiogapass.conf
```bitbake
KMACHINE = "aspeed"
KERNEL_DEVICETREE = "aspeed/${KMACHINE}-bmc-facebook-${MACHINE}.dtb"

PREFERRED_PROVIDER_virtual/bootloader = "u-boot-aspeed-sdk"
PREFERRED_PROVIDER_u-boot = "u-boot-aspeed-sdk"
PREFERRED_PROVIDER_u-boot-fw-utils = "u-boot-fw-utils-aspeed-sdk"

UBOOT_DEVICETREE = "ast2500-evb"
UBOOT_MACHINE = "evb-ast2500_defconfig"

OBMC_COMPATIBLE_NAMES = "com.meta.Hardware.BMC.Model.TiogaPass"

# Disable the "Pin Thief" Multi-GPIO Monitor
SYSTEMD_MASK:pn-phosphor-gpio-monitor = "phosphor-multi-gpio-monitor.service"
OBMC_IMAGE_EXTRA_INSTALL:append = " x86-power-control"

require conf/distro/include/phosphor-static-norootfs.inc
require conf/machine/include/facebook-compute-singlehost.inc
require conf/machine/include/ast2500.inc
require conf/machine/include/obmc-bsp-common.inc

#FLASH_SIZE = "32768"
FLASH_SIZE = "65536"
FLASH_KERNEL_OFFSET = "1024"
FLASH_ROFS_OFFSET = "40960"
FLASH_RWFS_OFFSET = "41984"
```
